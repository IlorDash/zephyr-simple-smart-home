## drivers/sensor/mock_sensor/Kconfig
```kconfig
config MOCK_SENSOR
	bool "Mock tempepature sensor"
	default y
	depends on DT_HAS_ZEPHYR_MOCK_SENSOR_ENABLED
	help
	  Enable mock temperature sensor
```

## dts/bindings/sensor/zephyr,mock-sensor.yaml
```yaml
description: |
  Mock temperature sensor.

  Example definition in devicetree:

    mock_sensor: mock-sensor {
      compatible = "zephyr,mock-sensor";
      sample-period = <1000>;
    };

include: sensor-device.yaml

compatible: "zephyr,mock-sensor"

properties:
  sample-period:
    type: int
    description: Sample period in ms.
```
